## app/boards/holyiot/holyiot_25055/Kconfig.holyiot_25055
```kconfig
# Holyiot 25008 board configuration

# SPDX-FileCopyrightText: Copyright (c) 2025 Clunky Machines
# SPDX-License-Identifier: Apache-2.0

config BOARD_HOLYIOT_25055
	select SOC_NRF54L05_CPUAPP if BOARD_HOLYIOT_25055_NRF54L05_CPUAPP
```

## app/boards/holyiot/holyiot_25055/board.yml
```yaml
board:
  name: holyiot_25055
  full_name: HOLYIOT 25055
  vendor: holyiot
  socs:
    - name: nrf54l05
```

## app/boards/nrf54lm20dk_nrf54lm20a_cpuapp.conf
```kconfig
# official samples say this is experimental and disabling it improves USB stability
CONFIG_UDC_DWC2_DMA=n

# the default is to block forever
CONFIG_UDC_DWC2_USBHS_VBUS_READY_TIMEOUT=100
```

## app/boards/ota_dfu.conf
```kconfig
CONFIG_BT_BUF_ACL_RX_SIZE=251
CONFIG_BT_BUF_ACL_TX_SIZE=251
CONFIG_BT_L2CAP_TX_MTU=247
CONFIG_IMG_MANAGER=y
CONFIG_MCUMGR_GRP_IMG=y
CONFIG_MCUMGR_GRP_OS=y
CONFIG_MCUMGR_GRP_STAT=y
CONFIG_MCUMGR_TRANSPORT_BT_CONN_PARAM_CONTROL=y
#CONFIG_MCUMGR_TRANSPORT_BT_DYNAMIC_SVC_REGISTRATION=y
CONFIG_MCUMGR_TRANSPORT_BT_PERM_RW_ENCRYPT=y
CONFIG_MCUMGR_TRANSPORT_BT=y
CONFIG_MCUMGR=y
CONFIG_STATS=y
CONFIG_STREAM_FLASH=y
CONFIG_ZCBOR=y

#CONFIG_BT_ATT_LOG_LEVEL_DBG=y
#CONFIG_BT_SMP_LOG_LEVEL_DBG=y
#CONFIG_MCUMGR_LOG_LEVEL_DBG=y
#CONFIG_MCUMGR_TRANSPORT_LOG_LEVEL_DBG=y
```

## app/boards/shorter_connection_intervals.conf
```kconfig
CONFIG_BT_LE_EXTENDED_FEAT_SET=y
CONFIG_BT_SUBRATING=y
CONFIG_BT_FRAME_SPACE_UPDATE=y
CONFIG_BT_SHORTER_CONNECTION_INTERVALS=y
CONFIG_BT_USER_PHY_UPDATE=y
```

## app/boards/xiao_ble.conf
```kconfig
CONFIG_BT_DEVICE_NAME="Flatbox rev7"
CONFIG_KERNEL_BIN_NAME="flatbox-rev7"
CONFIG_I2C=y
CONFIG_GPIO_MCP230XX=y
CONFIG_UART_CONSOLE=y
CONFIG_REBOOT=y
CONFIG_RETAINED_MEM=y
CONFIG_RETAINED_MEM_NRF_GPREGRET=y

# Undo some stuff that the board definition has enabled that we don't want.
CONFIG_BOARD_SERIAL_BACKEND_CDC_ACM=n
CONFIG_USB_DEVICE_STACK=n
CONFIG_USB_DEVICE_INITIALIZE_AT_BOOT=n
CONFIG_LOG_PROCESS_THREAD_STARTUP_DELAY_MS=0
```

## boards/arm/seeed_xiao_nrf52840/Kconfig.defconfig
```kconfig
# Seeed Studio XIAO nRF52840 board configuration

# Copyright (c) 2020 Tobias Svehagen
# SPDX-License-Identifier: Apache-2.0

if BOARD_SEEED_XIAO_NRF52840

config BOARD
	default "seeed_xiao_nrf52840"

config BT_CTLR
	default BT

config BT_DEVICE_NAME
	default "Flatbox rev7"

config KERNEL_BIN_NAME
	default "flatbox-rev7"

config I2C
	default y

config GPIO_MCP230XX
	default y

endif # BOARD_SEEED_XIAO_NRF52840
```
