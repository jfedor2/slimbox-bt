&pinctrl {
    spi2_sleep {
        group1 {
            psels = <NRF_PSEL(SPIM_SCK, 1, 13)>,
                <NRF_PSEL(SPIM_MOSI, 1, 15)>;
            low-power-enable;
        };
        group2 {
            psels = <NRF_PSEL(SPIM_MISO, 1, 14)>;
            low-power-enable;
            bias-pull-down;
        };
    };
};
